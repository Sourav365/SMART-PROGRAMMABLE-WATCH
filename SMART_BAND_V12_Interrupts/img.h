const unsigned char sourav [] PROGMEM = {
        0xff, 0xff, 0xff, 0xff, 0xff, 0xff, 0xff, 0xff, 0xff, 0xff, 0xff, 0xff, 0xff, 0x00, 0x00, 0x00, 
  0xff, 0xff, 0xff, 0xff, 0xff, 0xff, 0xff, 0xff, 0xff, 0xff, 0xff, 0xff, 0xfc, 0x00, 0x00, 0x00, 
  0xff, 0xff, 0xff, 0xff, 0xff, 0xff, 0xff, 0xff, 0xff, 0xff, 0xff, 0xff, 0xf8, 0x00, 0x00, 0x00, 
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  0xff, 0xff, 0xff, 0xff, 0xff, 0xff, 0xff, 0xff, 0xff, 0xff, 0xff, 0xff, 0xff, 0xf0, 0x00, 0x00
};
const unsigned char sign [] PROGMEM = {
  0x00, 0x00, 0x00, 0x00, 0x00, 0x00, 0x00, 0x00, 0x00, 0x00, 0x00, 0x00, 0x00, 0x00, 0x00, 0x00, 
  0x00, 0x00, 0x00, 0x00, 0x00, 0x00, 0x00, 0x00, 0x00, 0x00, 0x00, 0x00, 0x00, 0x00, 0x00, 0x00, 
  0x00, 0x00, 0x00, 0x00, 0x00, 0x00, 0x00, 0x00, 0x00, 0x00, 0x00, 0x00, 0x00, 0x00, 0x00, 0x00, 
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  0x00, 0x00, 0x00, 0x00, 0x00, 0x00, 0x00, 0x00, 0x00, 0x00, 0x00, 0x00, 0x00, 0x00, 0x00, 0x00
  };

// 'Nababarsha-card_027', 128x32px
const unsigned char naba [] PROGMEM = {
  0xff, 0xff, 0xff, 0xff, 0xff, 0xff, 0xff, 0xff, 0xff, 0xff, 0xff, 0xff, 0xff, 0xff, 0xff, 0xff, 
  0xff, 0xff, 0xff, 0xff, 0xff, 0xff, 0xff, 0xff, 0xff, 0xf8, 0xff, 0xff, 0xff, 0xff, 0xf1, 0xff, 
  0xff, 0xf8, 0x41, 0x0a, 0x00, 0x7f, 0xff, 0xff, 0xff, 0xfc, 0x3f, 0xff, 0x00, 0x00, 0x03, 0xff, 
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  0xff, 0xff, 0xff, 0xff, 0xff, 0xff, 0xff, 0xff, 0xff, 0xff, 0xff, 0xff, 0xff, 0xff, 0xff, 0xff
};

// 'nga5im6', 128x32px
const unsigned char naba1 [] PROGMEM = {
  0xff, 0xff, 0xff, 0xff, 0xff, 0xff, 0xff, 0xff, 0xff, 0xff, 0xff, 0xff, 0xff, 0xff, 0xff, 0xff, 
  0xff, 0xff, 0xff, 0xff, 0xff, 0xff, 0xff, 0xc0, 0xff, 0xff, 0xff, 0xff, 0xff, 0xff, 0xff, 0xff, 
  0xff, 0xff, 0xff, 0xff, 0xff, 0xff, 0xf0, 0xc1, 0xc3, 0xff, 0xff, 0xff, 0xff, 0xff, 0xff, 0xff, 
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  0xff, 0xff, 0xff, 0xff, 0xff, 0xff, 0xff, 0xff, 0xff, 0xff, 0xff, 0xff, 0xff, 0xff, 0xff, 0xff
};
// 'images', 128x32px
const unsigned char naba2 [] PROGMEM = {
  0xff, 0xff, 0xff, 0xff, 0xff, 0xff, 0xff, 0xff, 0xff, 0xff, 0xff, 0xff, 0xff, 0xff, 0xff, 0xff, 
  0xff, 0xff, 0xff, 0xff, 0xff, 0xff, 0xff, 0xff, 0xff, 0xff, 0xff, 0xff, 0xff, 0xff, 0xff, 0xff, 
  0xff, 0xff, 0xff, 0xff, 0xff, 0xff, 0xff, 0xff, 0xff, 0xff, 0xff, 0xff, 0xff, 0xff, 0xff, 0xff, 
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  0xff, 0xff, 0xff, 0xff, 0xff, 0xff, 0xff, 0xff, 0xff, 0xff, 0xff, 0xff, 0xff, 0xff, 0xff, 0xff
};

// 'images', 128x64px
const unsigned char naba3 [] PROGMEM = {
// 'WhatsApp Image 2020-04-22 at 12', 128x64px
0xff, 0xff, 0xff, 0xff, 0xff, 0xd0, 0x7f, 0xff, 0xff, 0xff, 0xff, 0xe3, 0x00, 0x60, 0x80, 0x3f, 
0xff, 0xff, 0xff, 0xff, 0xff, 0xf0, 0xff, 0xff, 0xff, 0xfe, 0x7f, 0xe0, 0x00, 0x00, 0x00, 0x2d, 
0xff, 0xff, 0xff, 0xff, 0xff, 0xf1, 0xff, 0xff, 0xff, 0xec, 0x61, 0x80, 0x00, 0x00, 0x00, 0x3f, 
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0xff, 0xff, 0xff, 0xff, 0xb0, 0xe0, 0x00, 0x03, 0x20, 0xbb, 0xef, 0xff, 0x40, 0x90, 0x00, 0x00
};


#define noImage 6
void image()
{
  int ic = 1;
  while(1){
    int next = digitalRead(s2);
    int esc = digitalRead(s1);
    if(next == 1)
      {
        delay(500);
        if(ic == noImage)
            ic = 1;
        else
            ic += 1;
      }
    if(esc == 1)
    {
      delay(500);
      break;
    }    
    
    led.clearDisplay();
    led.setTextSize(1);
    led.setTextColor(1);

    if(ic == 1){
      led.drawBitmap(0, 0,  sourav, 128, 64, WHITE);
      led.display();
      //delay(3000);
    }
    if(ic == 2){
      led.clearDisplay();
      led.drawBitmap(0, 0,  sign, 128, 64, WHITE);
      led.display();
      //delay(3000);
    }
    if(ic == 3){
      led.clearDisplay();
      led.drawBitmap(0, 0,  naba, 128, 64, WHITE);
      led.display();
      //delay(3000);
    }
    if(ic == 4){
      led.clearDisplay();
      led.drawBitmap(0, 0,  naba1, 128, 64, WHITE);
      led.display();
      //delay(3000);
    }
    if(ic == 5){
      led.clearDisplay();
      led.drawBitmap(0, 0,  naba2, 128, 64, WHITE);
      led.display();
      //delay(3000);
    }
    if(ic == 6){
      led.clearDisplay();
      led.drawBitmap(0, 0,  naba3, 128, 64, WHITE);
      led.display();
      //delay(3000);
    }
    
  }
}
