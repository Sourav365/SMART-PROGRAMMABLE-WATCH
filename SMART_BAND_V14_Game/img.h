const unsigned char img1 [] PROGMEM = {
  // Sourav, 128x64px
  0x00, 0x00, 0x00, 0x37, 0xff, 0xcf, 0xff, 0xf3, 0xff, 0xfd, 0xff, 0xff, 0x3f, 0xff, 0xff, 0xff, 
  0x00, 0x00, 0x00, 0x2f, 0xff, 0xcf, 0xff, 0xf3, 0xff, 0xfd, 0xff, 0xff, 0x3f, 0xff, 0xff, 0xff, 
  0x00, 0x00, 0x00, 0x3f, 0xff, 0xcf, 0xff, 0xf3, 0xff, 0xfd, 0xff, 0xff, 0x3f, 0xff, 0xff, 0xff, 
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  0xf0, 0x00, 0x00, 0x01, 0x7f, 0x3f, 0xff, 0xcf, 0xff, 0xfb, 0xff, 0xfe, 0xff, 0xff, 0xff, 0xff
};
const unsigned char img2 [] PROGMEM = {
    // 'PHOTO', 128x64px
  0x00, 0x40, 0x00, 0x03, 0xff, 0xff, 0xff, 0xff, 0xff, 0xff, 0xff, 0xff, 0xff, 0xff, 0xff, 0xff, 
  0x40, 0x00, 0x00, 0x01, 0xff, 0xff, 0xff, 0xff, 0xff, 0xff, 0xff, 0xff, 0xff, 0xff, 0xff, 0xff, 
  0x40, 0x00, 0x00, 0x01, 0xff, 0xff, 0xff, 0xff, 0xff, 0xff, 0xff, 0xff, 0xff, 0xff, 0xff, 0xff, 
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  0x00, 0x10, 0x00, 0x00, 0x7f, 0xff, 0xff, 0xff, 0xff, 0xff, 0xff, 0xff, 0xff, 0xff, 0xff, 0xff
  };

const unsigned char img3 [] PROGMEM = {
    // 'IMG_20190215_174932', 128x64px
  0xfd, 0xff, 0x7f, 0xff, 0xff, 0xff, 0xff, 0xff, 0xff, 0xff, 0xff, 0xff, 0xff, 0xff, 0xff, 0xff, 
  0xff, 0xff, 0xff, 0xff, 0xff, 0xff, 0xff, 0xff, 0xff, 0xff, 0xff, 0xff, 0xff, 0xff, 0xff, 0xff, 
  0xdf, 0xfc, 0xff, 0xff, 0xff, 0xff, 0xff, 0xff, 0xff, 0xff, 0xff, 0xff, 0xff, 0xff, 0xff, 0xff, 
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  0xff, 0xff, 0xff, 0xff, 0xff, 0xff, 0xff, 0xff, 0xff, 0xff, 0xff, 0xff, 0xff, 0xff, 0xff, 0xff
};


const unsigned char img4 [] PROGMEM = {
    // 'IMG20200305155943 - Copy', 128x64px
  0xff, 0xff, 0xff, 0xff, 0xff, 0xff, 0xff, 0xff, 0xff, 0xff, 0xff, 0xff, 0xff, 0xff, 0xff, 0xff, 
  0xff, 0xff, 0xff, 0xff, 0xff, 0xff, 0xff, 0xff, 0xff, 0xff, 0xff, 0xff, 0xff, 0xff, 0xff, 0xff, 
  0xff, 0xff, 0xff, 0xff, 0xff, 0xff, 0xff, 0xff, 0xff, 0xff, 0xff, 0xff, 0xff, 0xff, 0xff, 0xff, 
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  0xc0, 0x01, 0x00, 0x0f, 0xdf, 0x87, 0x8f, 0xff, 0x7f, 0xff, 0xff, 0xff, 0xff, 0xff, 0xff, 0xff
};

const unsigned char img5 [] PROGMEM = {
    // PRATIK////, 128x64px
  0x00, 0xc7, 0xff, 0xff, 0xff, 0xff, 0xff, 0xff, 0xff, 0xf8, 0xff, 0xff, 0xff, 0xff, 0xff, 0xff, 
  0x00, 0x87, 0xff, 0xff, 0xff, 0xff, 0xff, 0xff, 0xff, 0xc0, 0x7f, 0xff, 0xff, 0xff, 0xff, 0xff, 
  0x00, 0x03, 0xff, 0xff, 0xff, 0xff, 0xff, 0xff, 0xff, 0xcf, 0xff, 0xff, 0xff, 0xff, 0xff, 0xff, 
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  0x00, 0x00, 0xe0, 0x0f, 0xf7, 0xff, 0x8e, 0x7f, 0xf7, 0xff, 0xff, 0xff, 0xff, 0xff, 0xff, 0xff
};


const unsigned char img6 [] PROGMEM = {
  // 'RAUSHAN', 128x64px
  0x00, 0x00, 0x00, 0x00, 0x00, 0x7f, 0xbf, 0xff, 0x7f, 0xfe, 0xff, 0xfd, 0xff, 0xff, 0xff, 0xf7, 
  0x00, 0x00, 0x00, 0x00, 0x00, 0x2f, 0xbf, 0xff, 0x7f, 0xfe, 0xff, 0xfd, 0xff, 0xfb, 0xff, 0xf7, 
  0x00, 0x00, 0x00, 0x00, 0x00, 0x1f, 0xbf, 0xff, 0x7f, 0xfe, 0xff, 0xff, 0xff, 0xfb, 0xff, 0xf7, 
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  0x00, 0x00, 0x00, 0x00, 0x00, 0x0d, 0xff, 0xfb, 0xff, 0xff, 0xff, 0xf7, 0xff, 0xef, 0xff, 0xdf
};


#define noImage 6
void image()
{
  int ic = 1;
  while(1){
    int next = digitalRead(s2);
    int esc = digitalRead(s1);
    if(next == 1)
      {
        delay(500);
        if(ic == noImage)
            ic = 1;
        else
            ic += 1;
      }
    if(esc == 1)
    {
      delay(500);
      break;
    }    
    
    led.clearDisplay();
    led.setTextSize(1);
    led.setTextColor(1);

    if(ic == 1){
      led.drawBitmap(0, 0,  img1, 128, 64, WHITE);
      led.display();
      //delay(3000);
    }
    if(ic == 2){
      led.clearDisplay();
      led.drawBitmap(0, 0,  img2, 128, 64, WHITE);
      led.display();
      //delay(3000);
    }
    if(ic == 3){
      led.clearDisplay();
      led.drawBitmap(0, 0,  img3, 128, 64, WHITE);
      led.display();
      //delay(3000);
    }
    if(ic == 4){
      led.clearDisplay();
      led.drawBitmap(0, 0,  img4, 128, 64, WHITE);
      led.display();
      //delay(3000);
    }
    if(ic == 5){
      led.clearDisplay();
      led.drawBitmap(0, 0,  img5, 128, 64, WHITE);
      led.display();
      //delay(3000);
    }
    if(ic == 6){
      led.clearDisplay();
      led.drawBitmap(0, 0,  img6, 128, 64, WHITE);
      led.display();
      //delay(3000);
    }
    
  }
}
